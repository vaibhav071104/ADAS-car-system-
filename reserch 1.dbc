VERSION ""

NS_ :

BS_:

BU_: controller camera

BO_ 0 detection1_msg: 2 camera
 SG_ detection1_y_signal : 8|8@1- (1,0) [0|0] ""  controller
 SG_ detection1_x_signal : 0|8@1- (1,0) [0|0] ""  controller

BA_DEF_  "BusType" STRING ;
BA_DEF_DEF_  "BusType" "CAN";
